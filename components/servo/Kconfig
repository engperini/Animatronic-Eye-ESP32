## components/servo/Kconfig
```kconfig
menu "Animatronic eye"
config EYE_PCA_SDA_GPIO
    int "PCA9685 SDA GPIO"
    range 0 48
    default 5
config EYE_PCA_SCL_GPIO
    int "PCA9685 SCL GPIO"
    range 0 48
    default 6
endmenu
```
